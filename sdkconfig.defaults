## sdkconfig.defaults
```kconfig
# ---------------------------------------------------------------
# Espressif IDF sdkconfig.defaults for Meshtastic ESP32 Unified OTA
# ===============================================================
# Goal: Minimize binary to <655360 bytes (OTA_1 partition limit)
# Current optimizations:
# - -Os + LTO + no asserts/paths/exceptions/RTTI
# - Logging OFF
# - NimBLE minimal (1 conn, BLE peripheral/broadcaster only)
# - LWIP IPv4-only, tiny buffers/sockets
# - mbedTLS minimal (SHA256/AES only, no TLS/EC/HTTPS)
# - No FS/ETH/GDB/Unity/HTTPD/SoftAP/WPA3/Mesh
# - Tiny FreeRTOS stacks/queues
# - Test incrementally with `pio run --target size`
# ---------------------------------------------------------------

# ---------------------------------------------------------------
# 1. Compiler & Linker Optimization (Aggressive Size)
# ---------------------------------------------------------------
# Optimize for size (-Os)
CONFIG_COMPILER_OPTIMIZATION_SIZE=y
CONFIG_COMPILER_OPTIMIZATION_DEFAULT=n
CONFIG_COMPILER_OPTIMIZATION_PERF=n

# Disable assertions (removes file paths/conditions)
CONFIG_COMPILER_OPTIMIZATION_ASSERTIONS_DISABLE=y
CONFIG_COMPILER_OPTIMIZATION_ASSERTIONS_ENABLE=n
CONFIG_COMPILER_OPTIMIZATION_ASSERTIONS_SILENT=n

# Hide paths/headers from binary
CONFIG_COMPILER_HIDE_PATHS_MACROS=y

# Disable C++ extras (no throw/RTTI)
CONFIG_COMPILER_CXX_EXCEPTIONS=n
CONFIG_COMPILER_CXX_RTTI=n

# Disable stack smashing (saves space)
CONFIG_COMPILER_STACK_CHECK_MODE_NONE=y

# LTO + linker tweaks
CONFIG_COMPILER_LTO=y
CONFIG_COMPILER_ORPHAN_SECTIONS_PLACE=n
# CONFIG_APP_RETRIEVE_LEN_ELF_SHA=0

# ---------------------------------------------------------------
# 2. Logging (Fully Disabled)
# ---------------------------------------------------------------
CONFIG_LOG_DEFAULT_LEVEL_NONE=y
CONFIG_LOG_DEFAULT_LEVEL=0
CONFIG_LOG_MAXIMUM_LEVEL=0
CONFIG_BOOTLOADER_LOG_LEVEL_NONE=y
CONFIG_LOG_IN_IRAM=n

# ---------------------------------------------------------------
# 3. Bluetooth / NimBLE (Minimal Peripheral OTA Server)
# ---------------------------------------------------------------
CONFIG_BT_ENABLED=y
CONFIG_BT_NIMBLE_ENABLED=y
CONFIG_BT_CONTROLLER_ENABLED=y
CONFIG_BT_CONTROLLER_DISABLED=n
CONFIG_BT_BLUEDROID_ENABLED=n

# Roles: Peripheral + Broadcaster only (no Central/Observer)
CONFIG_BT_NIMBLE_ROLE_CENTRAL=n
CONFIG_BT_NIMBLE_ROLE_OBSERVER=n
CONFIG_BT_NIMBLE_ROLE_PERIPHERAL=y
CONFIG_BT_NIMBLE_ROLE_BROADCASTER=y

# Minimal connections/bonds/memory
CONFIG_BT_NIMBLE_MAX_CONNECTIONS=1
CONFIG_BT_NIMBLE_MAX_BONDS=6
CONFIG_BT_NIMBLE_MAX_CCCDS=2
CONFIG_BTDM_CTRL_BLE_MAX_CONN=1
CONFIG_BTDM_CTRL_BLE_MAX_CONN_EFF=1
CONFIG_BT_NIMBLE_GATT_MAX_PROCS=4
CONFIG_BT_NIMBLE_WHITELIST_SIZE=4

CONFIG_BT_NIMBLE_ATT_PREFERRED_MTU=517


# No logging/services/persist if possible (keep NVS for bonds)
CONFIG_BT_NIMBLE_LOG_LEVEL_NONE=y
CONFIG_BT_NIMBLE_NVS_PERSIST=y
CONFIG_NIMBLE_CPP_LOG_LEVEL_NONE=y
CONFIG_BT_NIMBLE_PRINT_ERR_NAME=n

# Tiny memory pools
CONFIG_BT_NIMBLE_MSYS1_BLOCK_SIZE=512
CONFIG_BT_NIMBLE_MSYS1_BLOCK_COUNT=50
CONFIG_BT_NIMBLE_ACL_BUF_COUNT=24
CONFIG_BT_NIMBLE_ACL_BUF_SIZE=580
CONFIG_BT_NIMBLE_HCI_EVT_BUF_SIZE=100
CONFIG_BT_NIMBLE_HCI_EVT_HI_BUF_COUNT=40
CONFIG_BT_NIMBLE_HCI_EVT_LO_BUF_COUNT=12

# Disable all unused BLE services
CONFIG_BT_NIMBLE_PROX_SERVICE=n
CONFIG_BT_NIMBLE_ANS_SERVICE=n
CONFIG_BT_NIMBLE_CTS_SERVICE=n
CONFIG_BT_NIMBLE_HTP_SERVICE=n
CONFIG_BT_NIMBLE_IPSS_SERVICE=n
CONFIG_BT_NIMBLE_TPS_SERVICE=n
CONFIG_BT_NIMBLE_IAS_SERVICE=n
CONFIG_BT_NIMBLE_LLS_SERVICE=n
CONFIG_BT_NIMBLE_SPS_SERVICE=n
CONFIG_BT_NIMBLE_HR_SERVICE=n
CONFIG_BT_NIMBLE_BAS_SERVICE=n
CONFIG_BT_NIMBLE_DIS_SERVICE=n
CONFIG_BT_NIMBLE_HID_SERVICE=n

CONFIG_BT_NIMBLE_CRYPTO_STACK_MBEDTLS=y

# ---------------------------------------------------------------
# 4. Networking (LwIP - IPv4 Tiny STA Only)
# ---------------------------------------------------------------
CONFIG_LWIP_IPV6=n

# Tiny TCP/UDP/Sockets (1 TCP conn + UDP broadcast)
CONFIG_LWIP_MAX_SOCKETS=5
CONFIG_LWIP_MAX_UDP_PCBS=8
CONFIG_LWIP_MAX_RAW_PCBS=1
CONFIG_LWIP_MAX_ACTIVE_TCP=8
CONFIG_LWIP_MAX_LISTENING_TCP=5
CONFIG_LWIP_TCPIP_RECVMBOX_SIZE=16
CONFIG_LWIP_TCP_RECVMBOX_SIZE=4
CONFIG_LWIP_TCP_ACCEPTMBOX_SIZE=4
CONFIG_LWIP_UDP_RECVMBOX_SIZE=4

# Tiny buffers
CONFIG_LWIP_TCP_MSS=536
CONFIG_LWIP_TCP_WND_DEFAULT=2144
CONFIG_LWIP_TCP_SND_BUF_DEFAULT=2144

# No DHCP server/forwarding/stats
CONFIG_LWIP_DHCPS=n
CONFIG_LWIP_IP_FORWARD=n
CONFIG_LWIP_STATS=n

# ---------------------------------------------------------------
# 5. mbedTLS / Crypto (SHA256/AES Only - No TLS/HTTPS/EC)
# ---------------------------------------------------------------
# Minimal: Keep for WiFi/OTA hash (linker strips unused TLS)
CONFIG_MBEDTLS_INTERNAL_MEM_ALLOC=y
CONFIG_MBEDTLS_HARDWARE_AES=y
CONFIG_MBEDTLS_HARDWARE_SHA=y
CONFIG_MBEDTLS_AES_C=y
CONFIG_MBEDTLS_SHA256_C=y
CONFIG_MBEDTLS_CMAC_C=y
CONFIG_MBEDTLS_ROM_MD5=y
CONFIG_MBEDTLS_HARDWARE_MPI=n

# Disable all TLS/EC/X509/HTTPS (dead code stripped)
CONFIG_MBEDTLS_TLS_ENABLED=n
CONFIG_MBEDTLS_TLS_CLIENT=n
CONFIG_MBEDTLS_TLS_SERVER=n
CONFIG_MBEDTLS_SSL_PROTO_TLS1_2=n
CONFIG_MBEDTLS_KEY_EXCHANGE_RSA=n
CONFIG_MBEDTLS_KEY_EXCHANGE_ELLIPTIC_CURVE=n
CONFIG_MBEDTLS_ECP_C=n
CONFIG_MBEDTLS_ECDH_C=n
CONFIG_MBEDTLS_ECDSA_C=n
CONFIG_MBEDTLS_PK_PARSE_EC_COMPRESSED=n
CONFIG_MBEDTLS_CERTIFICATE_BUNDLE=n
CONFIG_MBEDTLS_ERROR_STRINGS=n
CONFIG_ESP_HTTP_CLIENT_ENABLE_HTTPS=n
CONFIG_ESP_HTTP_SERVER_ENABLE=n
CONFIG_ESP_HTTPS_SERVER_ENABLE=n
CONFIG_ESP_HTTP_SERVER_ENABLE=n
CONFIG_ESP_HTTPS_OTA_ALLOW_HTTP=n
CONFIG_WS_TRANSPORT=n

CONFIG_MBEDTLS_SSL_PROTO_TLS1_0=n
CONFIG_MBEDTLS_SSL_PROTO_TLS1_1=n
CONFIG_MBEDTLS_SSL_PROTO_DTLS=n
CONFIG_MBEDTLS_SSL_SRV_C=n
CONFIG_MBEDTLS_SSL_CLI_C=n
CONFIG_MBEDTLS_SSL_TLS_C=n

# ---------------------------------------------------------------
# 5b. Force-No EC/TLS Remnants
# ---------------------------------------------------------------
CONFIG_MBEDTLS_ASYMMETRIC_CONTENT_LEN=n
CONFIG_MBEDTLS_SSL_IN_CONTENT_LEN=0
CONFIG_MBEDTLS_SSL_OUT_CONTENT_LEN=0

# Kill EC (all curves; WiFi AES-only ok)
CONFIG_MBEDTLS_ECP_C=n
CONFIG_MBEDTLS_ECDH_C=n
CONFIG_MBEDTLS_ECDSA_C=n
CONFIG_MBEDTLS_ECP_DP_SECP192R1_ENABLED=n
CONFIG_MBEDTLS_ECP_DP_SECP224R1_ENABLED=n
CONFIG_MBEDTLS_ECP_DP_SECP256R1_ENABLED=n
CONFIG_MBEDTLS_ECP_DP_SECP384R1_ENABLED=n
CONFIG_MBEDTLS_ECP_DP_SECP521R1_ENABLED=n
CONFIG_MBEDTLS_ECP_DP_SECP192K1_ENABLED=n
CONFIG_MBEDTLS_ECP_DP_SECP224K1_ENABLED=n
CONFIG_MBEDTLS_ECP_DP_SECP256K1_ENABLED=n
CONFIG_MBEDTLS_ECP_DP_BP256R1_ENABLED=n
CONFIG_MBEDTLS_ECP_DP_BP384R1_ENABLED=n
CONFIG_MBEDTLS_ECP_DP_BP512R1_ENABLED=n
CONFIG_MBEDTLS_ECP_DP_CURVE25519_ENABLED=n
CONFIG_MBEDTLS_ECP_NIST_OPTIM=n
CONFIG_MBEDTLS_ECDSA_DETERMINISTIC=n

# ---------------------------------------------------------------
# 5b. Disable TLS Pullers / Selects (ESP-TLS, ProtoComm, Extras)
# ---------------------------------------------------------------
CONFIG_MBEDTLS_TLS_DISABLED=y
CONFIG_MBEDTLS_CLIENT_SSL_SESSION_TICKETS=n
CONFIG_MBEDTLS_SERVER_SSL_SESSION_TICKETS=n

# No ESP-TLS (plain HTTP OTA if needed; linker strips HTTPS)
CONFIG_ESP_TLS=n
CONFIG_ESP_TLS_USING_MBEDTLS=n

# ProtoComm: v0 only (insecure/no-TLS; GATT OTA direct for Meshtastic)
CONFIG_ESP_PROTOCOMM_SUPPORT_SECURITY_VERSION_0=y
CONFIG_ESP_PROTOCOMM_SUPPORT_SECURITY_VERSION_1=n
CONFIG_ESP_PROTOCOMM_SUPPORT_SECURITY_VERSION_2=n
CONFIG_PROTCOMM_ESP_BT=n

# No TLS stubs/pulls
CONFIG_FREERTOS_TLSP_DELETION_CALLBACKS=n

# Strip TLS/EC/X509 bloat (WiFi keeps AES/SHA only)
CONFIG_MBEDTLS_ECP_C=n
CONFIG_MBEDTLS_ECDH_C=n
CONFIG_MBEDTLS_ECDSA_C=n
CONFIG_MBEDTLS_PKCS7_C=n
CONFIG_MBEDTLS_FS_IO=n
CONFIG_MBEDTLS_HAVE_TIME=n
CONFIG_MBEDTLS_SSL_KEEP_PEER_CERTIFICATE=n
CONFIG_MBEDTLS_SSL_ALPN=n
CONFIG_MBEDTLS_PEM_PARSE_C=n
CONFIG_MBEDTLS_PEM_WRITE_C=n
CONFIG_MBEDTLS_X509_CRL_PARSE_C=n
CONFIG_MBEDTLS_X509_CSR_PARSE_C=n
CONFIG_MBEDTLS_SHA512_C=n
CONFIG_MBEDTLS_SHA1_C=n
CONFIG_MBEDTLS_GCM_C=n
CONFIG_MBEDTLS_CCM_C=n

# ---------------------------------------------------------------
# 6. System / FreeRTOS (Minimal Kernel)
# ---------------------------------------------------------------
# Nano newlib (no float printf)
CONFIG_NEWLIB_NANO_FORMAT=y

# Panic: Reboot only (no GDB/decode)
CONFIG_ESP_SYSTEM_PANIC_PRINT_REBOOT=y
CONFIG_ESP_SYSTEM_PANIC_GDBSTUB=n

# Tiny stacks/queues (safe for OTA tasks)
CONFIG_FREERTOS_IDLE_TASK_STACKSIZE=1024
CONFIG_FREERTOS_ISR_STACKSIZE=1024
CONFIG_FREERTOS_TIMER_TASK_STACK_DEPTH=1024
CONFIG_FREERTOS_MINIMAL_SHARED_STACK_SIZE=1024
CONFIG_FREERTOS_TIMER_QUEUE_LENGTH=5

# No IRAM bloat
CONFIG_ESP_ROM_PRINT_IN_IRAM=n
CONFIG_ESP_SYSTEM_IN_IRAM=n
CONFIG_LIBC_MISC_IN_IRAM=n
CONFIG_LIBC_LOCKS_PLACE_IN_IRAM=n
CONFIG_ESP_TIMER_IN_IRAM=n

# ---------------------------------------------------------------
# 7. WiFi / Project Specifics (STA-Only, WPA2)
# ---------------------------------------------------------------
# STA-only, no SoftAP/Mesh/WPA3/Enterprise
CONFIG_ESP_WIFI_SOFTAP_SUPPORT=n
CONFIG_ESP_WIFI_MESH_SUPPORT=n
CONFIG_ESP_WIFI_ENTERPRISE_SUPPORT=n
CONFIG_ESP_WIFI_ENABLE_WPA3_SAE=n
CONFIG_ESP_WIFI_ENABLE_WPA3_OWE_STA=n
CONFIG_ESP_WIFI_ENABLE_SAE_PK=n

# PHY: NVS-only calibration
CONFIG_ESP_PHY_INIT_DATA_IN_PARTITION=n
CONFIG_ESP_PHY_CALIBRATION_AND_DATA_STORAGE=y

# Partition tweaks
CONFIG_PARTITION_TABLE_MD5=n

# ---------------------------------------------------------------
# 8. Component Disables (Dead Code Elimination)
# ---------------------------------------------------------------
# No ETH/GDB/FS/Unity/HTTPD/VFS extras
CONFIG_ETH_ENABLED=n
CONFIG_ESP_GDBSTUB_ENABLED=n
CONFIG_FATFS_VOLUME_COUNT=0
CONFIG_SPIFFS_MAX_PARTITIONS=0
CONFIG_UNITY_ENABLE_IDF_TEST_RUNNER=n
CONFIG_UNITY_ENABLE_FLOAT=n
CONFIG_UNITY_ENABLE_DOUBLE=n
#CONFIG_HTTPD_MAX_REQ_HDR_LEN=0
#CONFIG_HTTPD_MAX_URI_LEN=0
#CONFIG_HTTPD_PURGE_BUF_LEN=0
CONFIG_VFS_SEMIHOSTFS_MAX_MOUNT_POINTS=0
CONFIG_VFS_INITIALIZE_DEV_NULL=n
CONFIG_MQTT_PROTOCOL_311=n
CONFIG_MQTT_TRANSPORT_SSL=n

# ---------------------------------------------------------------
# 9. Build / Bootloader Trims
# ---------------------------------------------------------------
CONFIG_APP_BUILD_GENERATE_BINARIES=n
CONFIG_APP_BUILD_BOOTLOADER=n
CONFIG_BOOTLOADER_COMPILER_OPTIMIZATION_SIZE=n
CONFIG_BOOTLOADER_LOG_LEVEL_NONE=n

CONFIG_LIBC_PICOLIBC=y
CONFIG_LIBC_NEWLIB=n

# Thread Matter Zigbee
CONFIG_OPENTHREAD_ENABLED=n
CONFIG_ZB_ENABLED=n
CONFIG_IEEE802154_ENABLED=n
CONFIG_SOC_MCPWM_SUPPORTED=n
CONFIG_ETM_ENABLE_DEBUG_LOG=n

CONFIG_ESPTOOLPY_FLASHSIZE_16MB=y
CONFIG_ESPTOOLPY_FLASHSIZE="16MB"
CONFIG_ESPTOOLPY_FLASHFREQ_40M=y
CONFIG_ESPTOOLPY_FLASHMODE_DIO=y
```
